## SETR_Assignment3/build/Kconfig/Kconfig.shield
```kconfig
osource "c:/setr/setr_assignment3/boards/shields/*/Kconfig.shield"
osource "C:/ncs/v2.6.0/nrf/boards/shields/*/Kconfig.shield"
```

## SETR_Assignment3/build/Kconfig/Kconfig.shield.defconfig
```kconfig
osource "c:/setr/setr_assignment3/boards/shields/*/Kconfig.defconfig"
osource "C:/ncs/v2.6.0/nrf/boards/shields/*/Kconfig.defconfig"
```
